/* Скрипт компоновки разделяемой библиотеки .ll (см. tools/elf2ll.py).
   База 0: значения символов в образе = смещения, загрузчик кладёт библиотеку
   по свободному адресу в памяти процесса и чинит релокации. */

SECTIONS
{
    . = 0;

    .text   : ALIGN(16) { *(.text*) }
    .rodata : ALIGN(16) { *(.rodata*) }
    .data   : ALIGN(16) { *(.data*) }
    /* .got держим явно и до .bss: его ячейки содержат адреса внутри образа,
       и загрузчик правит их так же, как обычные 64-битные релокации
       (см. tools/elf2ll.py). Если позволить компоновщику положить .got после
       .bss, эти ячейки не попали бы в файловую часть образа. */
    .got    : ALIGN(16) { *(.got) *(.got.plt) *(.igot*) }
    .bss    : ALIGN(16) { *(.bss*) *(COMMON) }

    /DISCARD/ : { *(.eh_frame) *(.comment) *(.note*) }
}
